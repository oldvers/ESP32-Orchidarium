## main/Kconfig.projbuild
```kconfig
menu "Orchidarium Configuration"

    orsource "$IDF_PATH/examples/common_components/env_caps/$IDF_TARGET/Kconfig.env_caps"

    config LED_STRIP_RGB_POWER_GPIO
        int "RGB LED strip power GPIO number"
        range ENV_GPIO_RANGE_MIN ENV_GPIO_OUT_RANGE_MAX
        default 27
        help
            GPIO number (IOxx) to power on the RGB LED strip.
            Some GPIOs are used for other purposes (flash connections, etc.) and cannot be used for RGB LED strip.

    config LED_STRIP_RGB_GPIO
        int "RGB LED strip GPIO number"
        range ENV_GPIO_RANGE_MIN ENV_GPIO_OUT_RANGE_MAX
        default 16
        help
            GPIO number (IOxx) to control the RGB LED strip.
            Some GPIOs are used for other purposes (flash connections, etc.) and cannot be used for RGB LED strip.

    config LED_STRIP_U_GPIO
        int "UV LED strip GPIO number"
        range ENV_GPIO_RANGE_MIN ENV_GPIO_OUT_RANGE_MAX
        default 26
        help
            GPIO number (IOxx) to control the UltraViolet LED strip.
            Some GPIOs are used for other purposes (flash connections, etc.) and cannot be used for RGB LED strip.

    config LED_STRIP_W_GPIO
        int "White LED strip GPIO number"
        range ENV_GPIO_RANGE_MIN ENV_GPIO_OUT_RANGE_MAX
        default 23
        help
            GPIO number (IOxx) to control the White LED strip.
            Some GPIOs are used for other purposes (flash connections, etc.) and cannot be used for RGB LED strip.

    config LED_STRIP_F_GPIO
        int "Fito LED strip GPIO number"
        range ENV_GPIO_RANGE_MIN ENV_GPIO_OUT_RANGE_MAX
        default 19
        help
            GPIO number (IOxx) to control the Fito LED strip.
            Some GPIOs are used for other purposes (flash connections, etc.) and cannot be used for RGB LED strip.

    config FAN_GPIO
        int "FAN GPIO number"
        range ENV_GPIO_RANGE_MIN ENV_GPIO_OUT_RANGE_MAX
        default 18
        help
            GPIO number (IOxx) to control the FAN.
            Some GPIOs are used for other purposes (flash connections, etc.) and cannot be used for RGB LED strip.

    config HUMIDIFIER_POWER_GPIO
        int "Humidifier power GPIO number"
        range ENV_GPIO_RANGE_MIN ENV_GPIO_OUT_RANGE_MAX
        default 5
        help
            GPIO number (IOxx) to control the power of Humidifier.
            Some GPIOs are used for other purposes (flash connections, etc.) and cannot be used for RGB LED strip.

    config HUMIDIFIER_BUTTON_GPIO
        int "Humidifier control button GPIO number"
        range ENV_GPIO_RANGE_MIN ENV_GPIO_OUT_RANGE_MAX
        default 17
        help
            GPIO number (IOxx) to turn the Humidifier on/off.
            Some GPIOs are used for other purposes (flash connections, etc.) and cannot be used for RGB LED strip.

    config I2C_SCL_GPIO
        int "I2C SCL GPIO number"
        range ENV_GPIO_RANGE_MIN ENV_GPIO_OUT_RANGE_MAX
        default 22
        help
            GPIO number (IOxx) to communicate with the I2C devices.
            Some GPIOs are used for other purposes (flash connections, etc.) and cannot be used for RGB LED strip.

    config I2C_SDA_GPIO
        int "I2C SDA GPIO number"
        range ENV_GPIO_RANGE_MIN ENV_GPIO_OUT_RANGE_MAX
        default 21
        help
            GPIO number (IOxx) to communicate with the I2C devices.
            Some GPIOs are used for other purposes (flash connections, etc.) and cannot be used for RGB LED strip.

endmenu
```

## sdkconfig.defaults.esp32
```kconfig
CONFIG_LED_STRIP_RGB_POWER_GPIO=27
CONFIG_LED_STRIP_RGB_GPIO=16
CONFIG_LED_STRIP_U_GPIO=26
CONFIG_LED_STRIP_W_GPIO=23
CONFIG_LED_STRIP_F_GPIO=19
CONFIG_FAN_GPIO=18
CONFIG_HUMIDIFIER_POWER_GPIO=5
CONFIG_HUMIDIFIER_BUTTON_GPIO=17
CONFIG_SENSORS_I2C_SCL_GPIO=22
CONFIG_SENSORS_I2C_SDA_GPIO=21
```
